// SPDX-License-Identifier: (GPL-2.0 OR MIT)
/*
 * Copyright (C) 2025 Google Inc.
 */
/dts-v1/;
#include "mt8189-skywalker-tarkin.dtsi"

/ {
	model = "Google Tarkin sku4096/unprovisioned design";
	compatible = "google,tarkin-sku4096", "google,tarkin-sku2147483647",
		     "google,tarkin", "mediatek,mt8189";
};

&cros_ec {
	keyboard-backlight {
		compatible = "google,cros-kbd-led-backlight";
	};
};
