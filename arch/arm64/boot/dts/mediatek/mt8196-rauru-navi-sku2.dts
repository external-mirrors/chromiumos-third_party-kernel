// SPDX-License-Identifier: (GPL-2.0 OR MIT)
/*
 * Copyright 2024 Google LLC
 */

/dts-v1/;
#include "mt8196-rauru-navi.dtsi"

/ {
	model = "Google Navi sku2 board";
	compatible = "google,navi-sku2", "google,navi-sku7", "google,navi", "mediatek,mt8196";
};

&i2c2 {
	status = "disabled";
};
