// SPDX-License-Identifier: (GPL-2.0 OR MIT)
/*
 * Copyright (C) 2025 Google Inc.
 */
/dts-v1/;
/plugin/;

#include <dt-bindings/input/cros-ec-keyboard.h>
#include <dt-bindings/input/input.h>

&keyboard_controller {
	function-row-physmap = <
		MATRIX_KEY(0x00, 0x02, 0)        /* T1 */
		MATRIX_KEY(0x03, 0x02, 0)        /* T2 */
		MATRIX_KEY(0x02, 0x02, 0)        /* T3 */
		MATRIX_KEY(0x01, 0x02, 0)        /* T4 */
		MATRIX_KEY(0x03, 0x04, 0)        /* T5 */
		MATRIX_KEY(0x02, 0x04, 0)        /* T6 */
		MATRIX_KEY(0x01, 0x04, 0)        /* T7 */
		MATRIX_KEY(0x02, 0x09, 0)        /* T8 */
		MATRIX_KEY(0x01, 0x09, 0)        /* T9 */
		MATRIX_KEY(0x00, 0x04, 0)        /* T10 */
		MATRIX_KEY(0x00, 0x01, 0)        /* T11 */
		MATRIX_KEY(0x01, 0x05, 0)        /* T12 */
	>;

	linux,keymap = <
		CROS_STD_MAIN_KEYMAP
		MATRIX_KEY(0x00, 0x02, KEY_BACK)           /* T1 */
		MATRIX_KEY(0x03, 0x02, KEY_REFRESH)        /* T2 */
		MATRIX_KEY(0x02, 0x02, KEY_ZOOM)           /* T3 */
		MATRIX_KEY(0x01, 0x02, KEY_SCALE)          /* T4 */
		MATRIX_KEY(0x03, 0x04, KEY_SYSRQ)          /* T5 */
		MATRIX_KEY(0x02, 0x04, KEY_BRIGHTNESSDOWN) /* T6 */
		MATRIX_KEY(0x01, 0x04, KEY_BRIGHTNESSUP)   /* T7 */
		MATRIX_KEY(0x02, 0x09, KEY_MUTE)           /* T8 */
		MATRIX_KEY(0x01, 0x09, KEY_VOLUMEDOWN)     /* T9 */
		MATRIX_KEY(0x00, 0x04, KEY_VOLUMEUP)       /* T10 */
		MATRIX_KEY(0x00, 0x01, KEY_MICMUTE)        /* T11 */
		MATRIX_KEY(0x01, 0x05, KEY_CONTROLPANEL)   /* T12 */
		MATRIX_KEY(0x03, 0x05, KEY_PREVIOUSSONG)   /* T13 */
		MATRIX_KEY(0x00, 0x09, KEY_PLAYPAUSE)      /* T14 */
		MATRIX_KEY(0x00, 0x0b, KEY_NEXTSONG)       /* T15 */
		MATRIX_KEY(0x03, 0x00, KEY_LEFTMETA)       /* Search*/
		MATRIX_KEY(0x01, 0x0e, KEY_LEFTCTRL)       /* Left Control*/
		MATRIX_KEY(0x06, 0x0d, KEY_LEFTALT)        /* Left ALT*/
		MATRIX_KEY(0x03, 0x0e, KEY_RIGHTCTRL)      /* Right Control*/
		MATRIX_KEY(0x06, 0x0a, KEY_BACKSLASH)      /* BACKSLASH*/
	>;
};

