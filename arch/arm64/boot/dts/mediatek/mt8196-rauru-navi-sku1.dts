// SPDX-License-Identifier: (GPL-2.0 OR MIT)
/*
 * Copyright 2024 Google LLC
 */

/dts-v1/;
#include "mt8196-rauru-navi.dtsi"

/ {
	model = "Google Navi sku1 board";
	compatible = "google,navi-sku1", "google,navi", "mediatek,mt8196";
};

&spi_ap_fp {
	status = "disabled";
};

&i2c2 {
	status = "disabled";
};
