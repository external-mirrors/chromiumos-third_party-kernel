// SPDX-License-Identifier: (GPL-2.0 OR MIT)
/*
 * Copyright (C) 2026 Google Inc.
 */
/dts-v1/;
/plugin/;

#include <dt-bindings/gpio/gpio.h>
#include <dt-bindings/interrupt-controller/irq.h>

&ap_i2c_tchscr {
	status = "okay";

	/* ELAN eKTH5012 / eKTH5012C */
	touchscreen@10 {
		compatible = "elan,ekth3500";
		reg = <0x10>;
		interrupts-extended = <&pio 15 IRQ_TYPE_LEVEL_LOW>;
		pinctrl-names = "default";
		pinctrl-0 = <&touchscreen_pins>;
		reset-gpios = <&pio 126 GPIO_ACTIVE_LOW>;
		vcc33-supply = <&pp3300_tchscr_x>;
		vccio-supply = <&pp1800_tchscr_report_disable>;
		status = "okay";
	};
};
