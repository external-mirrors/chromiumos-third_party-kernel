// SPDX-License-Identifier: (GPL-2.0 OR MIT)
/*
 * Copyright (C) 2025 Google Inc.
 */
/dts-v1/;
#include "mt8189-skywalker-grogu.dtsi"

/ {
	model = "Google Grogu sku1310720 board";
	compatible = "google,grogu-sku1310720", "google,grogu-sku1310721",
		     "google,grogu-sku1310724", "google,grogu-sku1310725",
		     "google,grogu-sku1310728", "google,grogu-sku1310729",
		     "google,grogu-sku1310732", "google,grogu-sku1310733",
		     "google,grogu-sku1310736", "google,grogu-sku1310737",
		     "google,grogu-sku1310740", "google,grogu-sku1310741",
		     "google,grogu-sku1310744", "google,grogu-sku1310745",
		     "google,grogu-sku1310748", "google,grogu-sku1310749",
		     "google,grogu", "mediatek,mt8189";
	chassis-type = "laptop";
};

/* non-touchscreen */
&ap_i2c_tchscr {
	status = "disabled";
};
