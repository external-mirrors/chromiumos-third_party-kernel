// SPDX-License-Identifier: (GPL-2.0 OR MIT)
/*
 * Copyright (C) 2025 Google Inc.
 *
 * Sku id: cached_sku_code & 0xFFFFFF00 | panel_id
 * panel_id:
 *	MIPI_TIANMA_TL121BVMS07_00 0x22
 */
/dts-v1/;
#include "mt8189-skywalker-padme.dtsi"

/ {
	model = "Google Padme unprovisioned/sku802 board";
	compatible = "google,padme-sku2147483426", "google,padme-sku802",
		     "google,padme", "mediatek,mt8189";
};
