// SPDX-License-Identifier: (GPL-2.0 OR MIT)
/*
 * Copyright 2025 Google LLC
 */

/dts-v1/;
#include "mt8196-rauru-navi.dtsi"

/ {
	model = "Google Navi sku5 board";
	compatible = "google,navi-sku5", "google,navi", "mediatek,mt8196";
};

&spi_ap_fp {
	status = "disabled";
};
