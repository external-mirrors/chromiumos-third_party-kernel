// SPDX-License-Identifier: (GPL-2.0 OR MIT)
/*
 * Copyright (C) 2025 Google Inc.
 */
/dts-v1/;
/plugin/;

#include <dt-bindings/input/cros-ec-keyboard.h>
#include <dt-bindings/input/input.h>

/* update when US KB available */

&keyboard_controller {
	keypad,num-columns = <18>;

	function-row-physmap = <
		MATRIX_KEY(0x00, 0x02, 0)        /* T1 */
		MATRIX_KEY(0x03, 0x02, 0)        /* T2 */
		MATRIX_KEY(0x02, 0x02, 0)        /* T3 */
		MATRIX_KEY(0x01, 0x02, 0)        /* T4 */
		MATRIX_KEY(0x04, 0x04, 0)        /* T5 */
		MATRIX_KEY(0x02, 0x04, 0)        /* T6 */
		MATRIX_KEY(0x01, 0x04, 0)        /* T7 */
		MATRIX_KEY(0x02, 0x0b, 0)        /* T8 */
		MATRIX_KEY(0x01, 0x09, 0)        /* T9 */
		MATRIX_KEY(0x00, 0x04, 0)        /* T10 */
		MATRIX_KEY(0x00, 0x01, 0)        /* T11 */
		MATRIX_KEY(0x01, 0x05, 0)        /* T12 */
		MATRIX_KEY(0x03, 0x05, 0)        /* T13 */
	>;

	linux,keymap = <

		CROS_TOP_ROW_KEYMAP_V30
		CROS_MAIN_KEYMAP_V30

		MATRIX_KEY(0x00, 0x02, KEY_BACK)                        /* T1 */
		MATRIX_KEY(0x03, 0x02, KEY_REFRESH)                     /* T2 */
		MATRIX_KEY(0x02, 0x02, KEY_ZOOM)                        /* T3 */
		MATRIX_KEY(0x01, 0x02, KEY_SCALE)                       /* T4 */
		MATRIX_KEY(0x04, 0x04, KEY_SYSRQ)                       /* T5 */
		MATRIX_KEY(0x02, 0x04, KEY_BRIGHTNESSDOWN)              /* T6 */
		MATRIX_KEY(0x01, 0x04, KEY_BRIGHTNESSUP)                /* T7 */
		MATRIX_KEY(0x02, 0x0b, KEY_DICTATE)                     /* T8 */
		MATRIX_KEY(0x01, 0x09, KEY_PLAYPAUSE)                   /* T9 */
		MATRIX_KEY(0x00, 0x04, KEY_MICMUTE)                     /* T10 */
		MATRIX_KEY(0x00, 0x01, KEY_MUTE)                        /* T11 */
		MATRIX_KEY(0x01, 0x05, KEY_VOLUMEDOWN)                  /* T12 */
		MATRIX_KEY(0x03, 0x05, KEY_VOLUMEUP)                    /* T13 */

		/* Define keys missing from standard_v30.c for OS-level recognition */
		MATRIX_KEY(0x00, 0x0d, KEY_RIGHTALT)                    /* 62: Right Alt */
		MATRIX_KEY(0x04, 0x0a, KEY_FN)                          /* 127: Left FN */
		MATRIX_KEY(0x06, 0x0f, KEY_CAPSLOCK)                    /* 128: CAPS LOCK */
		MATRIX_KEY(0x03, 0x00, KEY_LEFTMETA)                    /* 30: G KEY (Search) */
	>;
};

