// SPDX-License-Identifier: (GPL-2.0 OR MIT)
/*
 * Copyright (C) 2025 Google Inc.
 */
/dts-v1/;
#include "mt8189-skywalker-baze.dtsi"

/ {
	model = "Google Jye sku1048580/sku1048581 board";
	compatible = "google,baze-sku1048580", "google,baze-sku1048581",
		     "google,baze", "mediatek,mt8189";
	chassis-type = "laptop";
};

&keyboard_controller {
	linux,keymap = <
		CROS_TOP_ROW_KEYMAP_V30
		CROS_MAIN_KEYMAP_V30

		MATRIX_KEY(0x00, 0x02, KEY_BACK)		/* T1 */
		MATRIX_KEY(0x03, 0x02, KEY_REFRESH)		/* T2 */
		MATRIX_KEY(0x02, 0x02, KEY_ZOOM)		/* T3 */
		MATRIX_KEY(0x01, 0x02, KEY_SCALE)		/* T4 */
		MATRIX_KEY(0x04, 0x04, KEY_SYSRQ)		/* T5 */
		MATRIX_KEY(0x02, 0x04, KEY_BRIGHTNESSDOWN)	/* T6 */
		MATRIX_KEY(0x01, 0x04, KEY_BRIGHTNESSUP)	/* T7 */
		MATRIX_KEY(0x02, 0x0b, KEY_DICTATE)	        /* T8 */
		MATRIX_KEY(0x01, 0x09, KEY_ACCESSIBILITY)	/* T9 */
		MATRIX_KEY(0x00, 0x04, KEY_PLAYPAUSE)		/* T10 */
		MATRIX_KEY(0x00, 0x01, KEY_MICMUTE)		/* T11 */
		MATRIX_KEY(0x01, 0x05, KEY_MUTE)		/* T12 */
		MATRIX_KEY(0x03, 0x05, KEY_VOLUMEDOWN)		/* T13 */
		MATRIX_KEY(0x00, 0x0b, KEY_VOLUMEUP)		/* T14 */
		MATRIX_KEY(0x03, 0x0e, KEY_102ND)		/* Right key of Right Alt */
	>;
};
