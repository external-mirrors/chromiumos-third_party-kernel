// SPDX-License-Identifier: (GPL-2.0 OR MIT)
/*
 * Copyright (C) 2025 Google Inc.
 */
/dts-v1/;
#include "mt8189-skywalker-anakin.dtsi"

/ {
	model = "Google Anakin sku0/9/10/12/14/17/19/21/23/25/27/29/31/33/36/38
		/40/42/44/46/48/50/52/54/56/58/60/62/64/66/68/70/72/74/76/78 board";
	compatible = "google,anakin-sku0", "google,anakin-sku9",
		     "google,anakin-sku10", "google,anakin-sku12",
		     "google,anakin-sku14", "google,anakin-sku15",
		     "google,anakin-sku17", "google,anakin-sku19",
		     "google,anakin-sku21", "google,anakin-sku23",
		     "google,anakin-sku25", "google,anakin-sku27",
		     "google,anakin-sku29", "google,anakin-sku31",
		     "google,anakin-sku33", "google,anakin-sku36",
		     "google,anakin-sku38", "google,anakin-sku40",
		     "google,anakin-sku42", "google,anakin-sku44",
		     "google,anakin-sku46", "google,anakin-sku48",
		     "google,anakin-sku50", "google,anakin-sku52",
		     "google,anakin-sku54", "google,anakin-sku56",
		     "google,anakin-sku58", "google,anakin-sku60",
		     "google,anakin-sku62", "google,anakin-sku64",
		     "google,anakin-sku66", "google,anakin-sku68",
		     "google,anakin-sku70", "google,anakin-sku72",
		     "google,anakin-sku74", "google,anakin-sku76",
		     "google,anakin-sku78", "google,anakin",
		     "mediatek,mt8189";
};

&ap_i2c_tchscr {
	status = "disabled";
};

&keyboard_controller {
	keypad,num-columns = <18>;

	function-row-physmap = <
		MATRIX_KEY(0x00, 0x02, 0)        /* T1 */
		MATRIX_KEY(0x03, 0x02, 0)        /* T2 */
		MATRIX_KEY(0x02, 0x02, 0)        /* T3 */
		MATRIX_KEY(0x01, 0x02, 0)        /* T4 */
		MATRIX_KEY(0x04, 0x04, 0)        /* T5 */
		MATRIX_KEY(0x02, 0x04, 0)        /* T6 */
		MATRIX_KEY(0x01, 0x04, 0)        /* T7 */
		MATRIX_KEY(0x02, 0x0b, 0)        /* T8 */
		MATRIX_KEY(0x01, 0x09, 0)        /* T9 */
		MATRIX_KEY(0x00, 0x04, 0)        /* T10 */
		MATRIX_KEY(0x00, 0x01, 0)        /* T11 */
		MATRIX_KEY(0x01, 0x05, 0)        /* T12 */
		MATRIX_KEY(0x03, 0x05, 0)        /* T13 */
		MATRIX_KEY(0x00, 0x0b, 0)        /* T14 */
	>;

	linux,keymap = <
		CROS_TOP_ROW_KEYMAP_V30
		CROS_MAIN_KEYMAP_V30
		MATRIX_KEY(0x00, 0x02, KEY_BACK)            /* T1 */
		MATRIX_KEY(0x03, 0x02, KEY_REFRESH)         /* T2 */
		MATRIX_KEY(0x02, 0x02, KEY_ZOOM)            /* T3 */
		MATRIX_KEY(0x01, 0x02, KEY_SCALE)           /* T4 */
		MATRIX_KEY(0x04, 0x04, KEY_SYSRQ)           /* T5 */
		MATRIX_KEY(0x02, 0x04, KEY_BRIGHTNESSDOWN)  /* T6 */
		MATRIX_KEY(0x01, 0x04, KEY_BRIGHTNESSUP)    /* T7 */
		MATRIX_KEY(0x02, 0x0b, KEY_MUTE)            /* T8 */
		MATRIX_KEY(0x01, 0x09, KEY_VOLUMEDOWN)      /* T9 */
		MATRIX_KEY(0x00, 0x04, KEY_VOLUMEUP)        /* T10 */
		MATRIX_KEY(0x00, 0x01, KEY_MICMUTE)         /* T11 */
		MATRIX_KEY(0x01, 0x05, KEY_CONTROLPANEL)    /* T12 */
		MATRIX_KEY(0x03, 0x05, KEY_PREVIOUSSONG)    /* T13 */
		MATRIX_KEY(0x00, 0x0b, KEY_PLAYPAUSE)       /* T14 */
		MATRIX_KEY(0x02, 0x09, KEY_NEXTSONG)        /* 76 */
		MATRIX_KEY(0x03, 0x00, KEY_LEFTMETA)        /* Search*/
		MATRIX_KEY(0x01, 0x0e, KEY_LEFTCTRL)        /* Left Control*/
		MATRIX_KEY(0x06, 0x0d, KEY_LEFTALT)         /* Left ALT*/
		MATRIX_KEY(0x03, 0x0e, KEY_RIGHTCTRL)       /* Right Control*/
		MATRIX_KEY(0x02, 0x07, KEY_102ND)           /* 45 */
		MATRIX_KEY(0x06, 0x0a, KEY_BACKSLASH)       /* 42 */
		MATRIX_KEY(0x02, 0x0a, KEY_YEN)             /* JP */
		MATRIX_KEY(0x04, 0x0a, KEY_FN)              /* FN */
	>;
};
