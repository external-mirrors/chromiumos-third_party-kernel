// SPDX-License-Identifier: (GPL-2.0 OR MIT)
/*
 * Copyright (C) 2025 Google Inc.
 */
/dts-v1/;
#include "mt8189-skywalker-grogu.dtsi"

/ {
	model = "Google starros sku1114113 board";
	compatible = "google,grogu-sku1114113", "google,grogu-sku1114115",
		     "google,grogu-sku1114117", "google,grogu-sku1114119",
		     "google,grogu-sku1114121", "google,grogu-sku1114123",
		     "google,grogu-sku1114125", "google,grogu-sku1114127",
		     "google,grogu", "mediatek,mt8189";
	chassis-type = "laptop";
};
