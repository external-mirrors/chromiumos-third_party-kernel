// SPDX-License-Identifier: (GPL-2.0 OR MIT)
/*
 * Copyright (C) 2025 Google Inc.
 */
/dts-v1/;
#include "mt8189-skywalker-baze.dtsi"

/ {
	model = "Google Shaak sku2097153 board";
	compatible = "google,baze-sku2097153", "google,baze", "mediatek,mt8189";
	chassis-type = "laptop";
};
