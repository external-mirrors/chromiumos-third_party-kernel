// SPDX-License-Identifier: (GPL-2.0 OR MIT)
/*
 * Copyright 2026 Google LLC
 */

/dts-v1/;
#include "mt8186-corsola-ponyta.dtsi"

/ {
	model = "Google Ponyta sku4096 board";
	compatible = "google,ponyta-sku4096", "google,ponyta", "mediatek,mt8186";
};
