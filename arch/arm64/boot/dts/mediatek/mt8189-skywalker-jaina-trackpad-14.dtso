// SPDX-License-Identifier: (GPL-2.0 OR MIT)
/*
 * Copyright (C) 2025 Google Inc.
 */
/dts-v1/;
/plugin/;

#include <dt-bindings/interrupt-controller/irq.h>

&ap_i2c_tchpad {
	status = "okay";

	/* ELAN SC479A-24HJ */
	trackpad_elan_14: trackpad@15 {
		compatible = "hid-over-i2c";
		reg = <0x15>;
		hid-descr-addr = <0x0001>;
		post-power-on-delay-ms = <30>;
		interrupts-extended = <&pio 125 IRQ_TYPE_LEVEL_LOW>;
		pinctrl-names = "default";
		pinctrl-0 = <&trackpad_pins>;
		wakeup-source;
		vdd-supply = <&pp3300_s3>;
		status = "fail-needs-probe";
	};

	/* Synaptics TM-03860-001 */
	trackpad_synaptics: trackpad@2c {
		compatible = "hid-over-i2c";
		reg = <0x2c>;
		/* If the start addr is main descriptor(0x20), and the main descriptor register offset = 0 */
		hid-descr-addr = <0x0000>;
		post-power-on-delay-ms = <20>;
		interrupts-extended = <&pio 125 IRQ_TYPE_LEVEL_LOW>;
		pinctrl-names = "default";
		pinctrl-0 = <&trackpad_pins>;
		wakeup-source;
		vdd-supply = <&pp3300_s3>;
		status = "fail-needs-probe";
	};
};
