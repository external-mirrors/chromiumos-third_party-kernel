// SPDX-License-Identifier: (GPL-2.0 OR MIT)
/*
 * Copyright (C) 2025 Google Inc.
 */
/dts-v1/;
/plugin/;

#include <dt-bindings/input/cros-ec-keyboard.h>
#include <dt-bindings/input/input.h>

&cros_ec {
	keyboard-backlight {
		compatible = "google,cros-kbd-led-backlight";
	};
};

&keyboard_controller {
	function-row-physmap = <
		MATRIX_KEY(0x00, 0x02, 0)        /* T1 */
		MATRIX_KEY(0x03, 0x02, 0)        /* T2 */
		MATRIX_KEY(0x02, 0x02, 0)        /* T3 */
		MATRIX_KEY(0x01, 0x02, 0)        /* T4 */
		MATRIX_KEY(0x03, 0x04, 0)        /* T5 */
		MATRIX_KEY(0x02, 0x04, 0)        /* T6 */
		MATRIX_KEY(0x01, 0x04, 0)        /* T7 */
		MATRIX_KEY(0x02, 0x09, 0)        /* T8 */
		MATRIX_KEY(0x01, 0x09, 0)        /* T9 */
		MATRIX_KEY(0x00, 0x04, 0)        /* T10 */
		MATRIX_KEY(0x00, 0x01, 0)        /* T11 */
		MATRIX_KEY(0x01, 0x05, 0)        /* T12 */
		MATRIX_KEY(0x03, 0x05, 0)        /* T13 */
	>;
	linux,keymap = <
		CROS_STD_MAIN_KEYMAP
		MATRIX_KEY(0x00, 0x02, KEY_BACK)           /* T1 */
		MATRIX_KEY(0x03, 0x02, KEY_REFRESH)        /* T2 */
		MATRIX_KEY(0x02, 0x02, KEY_ZOOM)           /* T3 */
		MATRIX_KEY(0x01, 0x02, KEY_SCALE)          /* T4 */
		MATRIX_KEY(0x03, 0x04, KEY_SYSRQ)          /* T5 */
		MATRIX_KEY(0x02, 0x04, KEY_BRIGHTNESSDOWN) /* T6 */
		MATRIX_KEY(0x01, 0x04, KEY_BRIGHTNESSUP)   /* T7 */
		MATRIX_KEY(0x02, 0x09, KEY_KBDILLUMTOGGLE) /* T8 */
		MATRIX_KEY(0x01, 0x09, KEY_PLAYPAUSE)      /* T9 */
		MATRIX_KEY(0x00, 0x04, KEY_MICMUTE)        /* T10 */
		MATRIX_KEY(0x00, 0x01, KEY_MUTE)           /* T11 */
		MATRIX_KEY(0x01, 0x05, KEY_VOLUMEDOWN)     /* T12 */
		MATRIX_KEY(0x03, 0x05, KEY_VOLUMEUP)       /* T13 */
		MATRIX_KEY(0x03, 0x00, KEY_LEFTMETA)       /* Search*/
		MATRIX_KEY(0x01, 0x0e, KEY_LEFTCTRL)       /* Left Control*/
		MATRIX_KEY(0x06, 0x0d, KEY_BACKSLASH)      /* KEY_BACKSLASH*/
		MATRIX_KEY(0x03, 0x0e, KEY_RIGHTCTRL)      /* Right Control*/
		MATRIX_KEY(0x06, 0x0a, KEY_LEFTALT)        /* KEY_LEFTALT*/
		MATRIX_KEY(0x04, 0x00, KEY_102ND)          /* KEY_102ND */
	>;
};
