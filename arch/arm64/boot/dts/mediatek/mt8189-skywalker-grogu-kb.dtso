// SPDX-License-Identifier: (GPL-2.0 OR MIT)
/*
 * Copyright (C) 2025 Google Inc.
 */
/dts-v1/;
/plugin/;

#include <dt-bindings/input/cros-ec-keyboard.h>
#include <dt-bindings/input/input.h>

&keyboard_controller {
	linux,keymap = <
		CROS_TOP_ROW_KEYMAP_V30
		CROS_MAIN_KEYMAP_V30

		MATRIX_KEY(0x00, 0x02, KEY_BACK)		/* T1 */
		MATRIX_KEY(0x03, 0x02, KEY_REFRESH)		/* T2 */
		MATRIX_KEY(0x02, 0x02, KEY_ZOOM)		/* T3 */
		MATRIX_KEY(0x01, 0x02, KEY_SCALE)		/* T4 */
		MATRIX_KEY(0x04, 0x04, KEY_SYSRQ)		/* T5 */
		MATRIX_KEY(0x02, 0x04, KEY_BRIGHTNESSDOWN)	/* T6 */
		MATRIX_KEY(0x01, 0x04, KEY_BRIGHTNESSUP)	/* T7 */
		MATRIX_KEY(0x02, 0x0b, KEY_DICTATE)		/* T8 */
		MATRIX_KEY(0x01, 0x09, KEY_PLAYPAUSE)		/* T9 */
		MATRIX_KEY(0x00, 0x04, KEY_MUTE)		/* T10 */
		MATRIX_KEY(0x00, 0x01, KEY_VOLUMEDOWN)		/* T11 */
		MATRIX_KEY(0x01, 0x05, KEY_VOLUMEUP)		/* T12 */
	>;
};
