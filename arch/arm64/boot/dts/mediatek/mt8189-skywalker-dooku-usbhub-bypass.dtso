// SPDX-License-Identifier: (GPL-2.0 OR MIT)
/*
 * Copyright (C) 2025 Google Inc.
 */
/dts-v1/;
/plugin/;

#include <dt-bindings/phy/phy.h>

&xhci0 {
	phys = <&u2port0 PHY_TYPE_USB2>,
		<&u3port0 PHY_TYPE_USB3>;
	mediatek,u3p-dis-msk = <0x0>;
	status = "okay";
};

/*This is a workaround; Disabling the node doesn't work.*/
&xhci3 {
	/delete-node/ hub@1;
	/delete-node/ hub@2;
};
