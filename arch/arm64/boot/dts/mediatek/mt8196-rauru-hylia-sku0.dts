// SPDX-License-Identifier: (GPL-2.0 OR MIT)
/*
 * Copyright 2025 Google LLC
 */

/dts-v1/;
#include "mt8196-rauru-hylia.dtsi"

/ {
	model = "Google Hylia unprovisioned design and sku0 board";
	compatible = "google,hylia-sku2147483647", "google,hylia-sku2147480063",
		     "google,hylia-sku2147480575", "google,hylia-sku0",
		     "google,hylia", "mediatek,mt8196";
};

&cros_ec {
	keyboard-backlight {
		compatible = "google,cros-kbd-led-backlight";
	};
};

/* C30BWL */
&keyboard_controller {
	linux,keymap = <
		CROS_TOP_ROW_KEYMAP_V30
		CROS_MAIN_KEYMAP_V30

		MATRIX_KEY(0x00, 0x02, KEY_BACK)		/* T1 */
		MATRIX_KEY(0x03, 0x02, KEY_REFRESH)		/* T2 */
		MATRIX_KEY(0x02, 0x02, KEY_ZOOM)		/* T3 */
		MATRIX_KEY(0x01, 0x02, KEY_SCALE)		/* T4 */
		MATRIX_KEY(0x04, 0x04, KEY_SYSRQ)		/* T5 */
		MATRIX_KEY(0x02, 0x04, KEY_BRIGHTNESSDOWN)	/* T6 */
		MATRIX_KEY(0x01, 0x04, KEY_BRIGHTNESSUP)	/* T7 */
		MATRIX_KEY(0x02, 0x0b, KEY_KBDILLUMTOGGLE)	/* T8 */
		MATRIX_KEY(0x01, 0x09, KEY_DICTATE)		/* T9 */
		MATRIX_KEY(0x00, 0x04, KEY_ACCESSIBILITY)	/* T10 */
		MATRIX_KEY(0x00, 0x01, KEY_MICMUTE)		/* T11 */
		MATRIX_KEY(0x01, 0x05, KEY_MUTE)		/* T12 */
		MATRIX_KEY(0x03, 0x05, KEY_VOLUMEDOWN)		/* T13 */
		MATRIX_KEY(0x00, 0x0b, KEY_VOLUMEUP)		/* T14 */
	>;
};
