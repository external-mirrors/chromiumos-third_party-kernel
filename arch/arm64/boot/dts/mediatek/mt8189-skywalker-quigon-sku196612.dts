// SPDX-License-Identifier: (GPL-2.0 OR MIT)
/*
 * Copyright (C) 2025 Google Inc.
 */
/dts-v1/;
#include "mt8189-skywalker-obiwan.dtsi"

/ {
	model = "Google Quigon sku196612/196613 board";
	compatible = "google,obiwan-sku196612", "google,obiwan-sku196613",
		     "google,obiwan", "mediatek,mt8189";
};

&ap_i2c_tchscr {
	status = "disabled";
};

&keyboard_controller {
	linux,keymap = <
		CROS_TOP_ROW_KEYMAP_V30
		CROS_MAIN_KEYMAP_V30

		MATRIX_KEY(0x00, 0x02, KEY_BACK)		/* T1 */
		MATRIX_KEY(0x03, 0x02, KEY_REFRESH)		/* T2 */
		MATRIX_KEY(0x02, 0x02, KEY_ZOOM)		/* T3 */
		MATRIX_KEY(0x01, 0x02, KEY_SCALE)		/* T4 */
		MATRIX_KEY(0x04, 0x04, KEY_SYSRQ)		/* T5 */
		MATRIX_KEY(0x02, 0x04, KEY_BRIGHTNESSDOWN)	/* T6 */
		MATRIX_KEY(0x01, 0x04, KEY_BRIGHTNESSUP)	/* T7 */
		MATRIX_KEY(0x02, 0x0b, KEY_PLAYPAUSE)		/* T8 */
		MATRIX_KEY(0x01, 0x09, KEY_MICMUTE)		/* T9 */
		MATRIX_KEY(0x00, 0x04, KEY_MUTE)		/* T10 */
		MATRIX_KEY(0x00, 0x01, KEY_VOLUMEDOWN)		/* T11 */
		MATRIX_KEY(0x01, 0x05, KEY_VOLUMEUP)		/* T12 */
		MATRIX_KEY(0x03, 0x05, KEY_ACCESSIBILITY)	/* T13 */
		MATRIX_KEY(0x00, 0x0b, KEY_DICTATE)		/* T14 */
	>;
};
