// SPDX-License-Identifier: (GPL-2.0 OR MIT)
/*
 * Copyright (C) 2025 Google Inc.
 *
 * Sku id: cached_sku_code & 0xFFFFFF00 | panel_id
 * panel_id:
 *	MIPI_TIANMA_TL121BVMS07_00 0x22
 */
/dts-v1/;
#include "mt8189-skywalker-padme.dtsi"

/ {
	model = "Google Padme sku290 board";
	compatible = "google,padme-sku290", "google,padme-sku1570",
		     "google,padme", "mediatek,mt8189";

	/delete-node/ connector-0;
	/delete-node/ connector-1;
};

&ap_sar_sensor {
	status = "disabled";
};

/*This is a workaround; further analysis is needed to determine why disabling
is not feasible.*/
&xhci3 {
	/delete-node/ hub@1;
	/delete-node/ hub@2;
};
