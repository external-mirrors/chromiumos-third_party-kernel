// SPDX-License-Identifier: (GPL-2.0 OR MIT)
/*
 * Copyright (C) 2025 Google Inc.
 */
/dts-v1/;
#include "mt8189-skywalker-baze.dtsi"

/ {
	model = "Google Jye sku1048576/sku1048577/sku1048584 board";
	compatible = "google,baze-sku1048576", "google,baze-sku1048577",
		     "google,baze-sku1048584", "google,baze", "mediatek,mt8189";
	chassis-type = "laptop";
};
