## Documentation/devicetree/bindings/display/mediatek/mediatek,mdp-rsz.yaml
```yaml
# SPDX-License-Identifier: (GPL-2.0-only OR BSD-2-Clause)
%YAML 1.2
---
$id: http://devicetree.org/schemas/display/mediatek/mediatek,mdp-rsz.yaml#
$schema: http://devicetree.org/meta-schemas/core.yaml#

title: MediaTek display multimedia data path resizer

maintainers:
  - Chun-Kuang Hu <chunkuang.hu@kernel.org>
  - Philipp Zabel <p.zabel@pengutronix.de>

description: |
  MediaTek display multimedia data path resizer, namely MDP-RSZ,
  can do scaling up/down to the picture.

properties:
  compatible:
    const: mediatek,mt8196-disp-mdp-rsz

  reg:
    maxItems: 1

  clocks:
    items:
      - description: MDP-RSZ Clock

required:
  - compatible
  - reg
  - clocks

additionalProperties: false

examples:
  - |
    #include <dt-bindings/clock/mt8196-clk.h>

    soc {
        #address-cells = <2>;
        #size-cells = <2>;

        disp_mdp_rsz0: disp-mdp-rsz0@321a0000 {
            compatible = "mediatek,mt8196-disp-mdp-rsz";
            reg = <0 0x321a0000 0 0x1000>;
            clocks = <&dispsys_config_clk CLK_MM_MDP_RSZ0_DISP>;
        };
    };
```

## Documentation/devicetree/bindings/input/ilitek,ili79900a.yaml
```yaml
# SPDX-License-Identifier: (GPL-2.0-only OR BSD-2-Clause)
%YAML 1.2
---
$id: http://devicetree.org/schemas/input/ilitek,ili79900a.yaml#
$schema: http://devicetree.org/meta-schemas/core.yaml#

title: Ilitek ILI79900A Touchscreen

maintainers:
  - Aaron Ye <aaron_ye@ilitek.corp-partner.google.com>

description: |
  Ilitek ILI79900A touchscreen controller using the HID over SPI protocol.

allOf:
  - $ref: /schemas/input/touchscreen/touchscreen.yaml#

properties:
  compatible:
    const: ilitek,ili79900a

  reg:
    maxItems: 1

  interrupts:
    maxItems: 1

  reset-gpios:
    description:
      Reset GPIO for the touchscreen controller (active high).
    maxItems: 1

  panel:
    description:
      Associated display panel.

  spi-cs-setup-delay-ns:
    description:
      SPI chip select setup delay in nanoseconds.

  vdd-supply:
    description:
      Regulator for the VDD supply voltage.

  input-report-header-address:
    $ref: /schemas/types.yaml#/definitions/uint32
    minimum: 0
    maximum: 0xffffff
    description:
      A value to be included in the Read Approval packet, listing an address of
      the input report header to be put on the SPI bus. This address has 24
      bits.

  input-report-body-address:
    $ref: /schemas/types.yaml#/definitions/uint32
    minimum: 0
    maximum: 0xffffff
    description:
     A value to be included in the Read Approval packet, listing an address of
      the input report body to be put on the SPI bus. This address has 24 bits.

  output-report-address:
    $ref: /schemas/types.yaml#/definitions/uint32
    minimum: 0
    maximum: 0xffffff
    description:
      A value to be included in the Output Report sent by the host, listing an
      address where the output report on the SPI bus is to be written to. This
      address has 24 bits.

  post-power-on-delay-ms:
    description:
      Optional time in ms required by the device after enabling its regulators
      or powering it on, before it is ready for communication.

  minimal-reset-delay-ms:
    description:
      Optional minimum amount of time in ms that device needs to be in reset
      state for the reset to take effect.

  read-opcode:
  $ref: /schemas/types.yaml#/definitions/uint8
    description:
      Value to be used in Read Approval packets. 1 byte.

  write-opcode:
  $ref: /schemas/types.yaml#/definitions/uint8
    description:
      Value to be used in Write Approval packets. 1 byte.


required:
  - compatible
  - interrupts
  - reset-gpios
  - panel
  - spi-cs-setup-delay-ns
  - input-report-header-address
  - input-report-body-address
  - output-report-address
  - post-power-on-delay-ms
  - minimal-reset-delay-ms
  - read-opcode
  - write-opcode

additionalProperties: false

examples:
  - |
    #include <dt-bindings/interrupt-controller/irq.h>
    #include <dt-bindings/gpio/gpio.h>

    spi {
        #address-cells = <1>;
        #size-cells = <0>;

        touchscreen: touchscreen@0 {
            compatible = "ilitek,ili79900a";
            reg = <0>;
            pinctrl-names = "default";
            pinctrl-0 = <&touchscreen_pins>;
            reset-gpios = <&pio 126 GPIO_ACTIVE_HIGH>;
            interrupts-extended = <&pio 15 IRQ_TYPE_EDGE_FALLING>;
            spi-max-frequency = <3000000>;
            spi-cs-setup-delay-ns = <2000>;
            panel = <&mipi_panel>;

            input-report-header-address = <0x001000>;
            input-report-body-address   = <0x001000>;
            output-report-address       = <0x002000>;
            read-opcode  = <0x83>;
            write-opcode = <0x82>;
            post-power-on-delay-ms = <0>;
            minimal-reset-delay-ms = <10>;
            status = "okay";
        };
    };
```

## Documentation/devicetree/bindings/media/google,fb-chameleonv3.yaml
```yaml
# SPDX-License-Identifier: (GPL-2.0-only OR BSD-2-Clause)
%YAML 1.2
---
$id: http://devicetree.org/schemas/media/google,fb-chameleonv3.yaml#
$schema: http://devicetree.org/meta-schemas/core.yaml#

title: Google Chameleon v3 Framebuffer

maintainers:
  - Paweł Anikiel <pan@semihalf.com>

description:
  The Google Chameleon v3 can act like a monitor which can be connected
  to an external device via HDMI or DisplayPort.

properties:
  compatible:
    const: google,fb-chameleonv3

  reg:
    maxItems: 1

  interrupts:
    maxItems: 1

required:
  - compatible
  - reg
  - interrupts

additionalProperties: false

examples:
  - |
    #include <dt-bindings/interrupt-controller/arm-gic.h>
    video@c0050000 {
        compatible = "google,fb-chameleonv3";
        reg = <0xc0050000 0x1010>;
        interrupts = <0 19 IRQ_TYPE_LEVEL_HIGH>;
    };
```

## Documentation/devicetree/bindings/pwm/pwm.yaml
```yaml
# SPDX-License-Identifier: GPL-2.0
%YAML 1.2
---
$id: http://devicetree.org/schemas/pwm/pwm.yaml#
$schema: http://devicetree.org/meta-schemas/core.yaml#

title: PWM controllers (providers)

maintainers:
  - Thierry Reding <thierry.reding@gmail.com>

properties:
  $nodename:
    pattern: "^pwm(@.*|-[0-9a-f])*$"

  "#pwm-cells":
    description: |
      Number of cells in a PWM specifier. Typically the cells represent, in
      order: the chip-relative PWM number, the PWM period in nanoseconds and
      optionally a number of flags (defined in <dt-bindings/pwm/pwm.h>).

required:
  - "#pwm-cells"

examples:
  - |
    pwm: pwm@7000a000 {
        compatible = "nvidia,tegra20-pwm";
        reg = <0x7000a000 0x100>;
        #pwm-cells = <2>;
    };
```

## drivers/cam/Kconfig
```kconfig
# SPDX-License-Identifier: GPL-2.0

menuconfig CAM
	bool "CAM"
	select DMA_SHARED_BUFFER
	select SYNC_FILE
	help
	  The CAM UAPI and framework.

	  Enable this if you have complex imaging related devices.

	  NOTE THAT THE CAM API IS EXPERIMENTAL. IT MAY NOT BE CONSIDERED
	  STABLE AT THE MOMENT.

	  The module will be called cam.ko.

config CAM_KUNIT_TESTS
	tristate "KUnit tests for cam" if !KUNIT_ALL_TESTS
	depends on CAM && KUNIT
	default KUNIT_ALL_TESTS
	help
	  This builds the cam KUnit tests.

	  KUnit tests run during boot and output the results to the debug log
	  in TAP format (https://testanything.org/). Only useful for kernel devs
	  running KUnit test harness and are not for inclusion into a production
	  build.

	  For more information on KUnit and unit tests in general please refer
	  to the KUnit documentation in Documentation/dev-tools/kunit/.

	  If unsure, say N.

if CAM

source "drivers/cam/platform/Kconfig"

endif # CAM
```

## drivers/cam/platform/vcam/Kconfig
```kconfig
# SPDX-License-Identifier: GPL-2.0

config CAM_VCAM
	tristate "Virtual camera driver"
	help
	  Driver for a virtual CAM device.

	  This driver creates a virtual CAM device that emulates a camera
	  without depending on any particular hardware. It can be used to test
	  both userspace code against the CAM API, and the CAM subsystem core.

	  The module will be called vcam.ko.
```

## drivers/gpu/mediatek/Kconfig
```kconfig
config MTK_GPU_SUPPORT
	bool "Support MTK GPU"
	help
	  config supports MTK GPU driver
	  CONFIG_MTK_GPU_SUPPORT defines
	  The gpu driver would be built-in, as kernel module or not supported

config MTK_GPUFREQ_V2
	bool "MTK GPUFREQ Version 2"
	depends on MTK_GPU_SUPPORT
	default y
	help
	  Support for gpufreq version 2.
	  CONFIG_MTK_GPUFREQ_V2 defines
	  if the gpufreq driver should go to version 2

config MTK_GPU_QOS_FRAMEWORK
	bool "MTK GPU QoS Framework"
	depends on MTK_GPU_SUPPORT
	default y
	help
	  This kernel config can be used to enable MTK QOS FRAMEWORK
	  for GPU QoS.

source "$(MALI_KCONFIG_EXT_PREFIX)drivers/gpu/mediatek/arm/Kconfig"
```

## drivers/interconnect/mediatek/Kconfig
```kconfig
# SPDX-License-Identifier: GPL-2.0

config INTERCONNECT_MTK
	bool "Mediatek Network-on-Chip interconnect drivers"
	depends on ARCH_MEDIATEK
	help
	  Support for Mediatek's Network-on-Chip interconnect hardware.

config INTERCONNECT_MTK_EMI
	tristate "Mediatek EMI interconnect driver"
	depends on INTERCONNECT_MTK
	help
	  This is a driver for the Mediatek Network-on-Chip on DVFSRC-based
	  platforms.

config INTERCONNECT_MTK_MMQOS_COMMON
	tristate "Mediatek MMQoS support"
	depends on INTERCONNECT_MTK
	depends on ARCH_DMA_ADDR_T_64BIT
	select INTERCONNECT_MTK_EXTENSION
	help
	  Support for multimedia QoS in Mediatek's SoCs.
	  The Mediatek MMQoS(Multimedia Quality of Service) Interconnect
	  driver will collect BW requests from MM users, such as display,
	  camera, mdp and video codec, and configure SMI settings dynamically
	  according to the aggregated BW.

config MTK_MMQOS_VCP
	tristate "MediaTek MMQOS VCP Support"
	depends on ARCH_MEDIATEK || COMPILE_TEST
	depends on INTERCONNECT_MTK
	depends on ARCH_DMA_ADDR_T_64BIT
	depends on MTK_SMI
	help
	  Say yes here to add support for the MediaTek Multimedia QoS (MMQOS)
	  for Video Control Processor (VCP). The MMQOS is used to set bw
	  for Mediatek multimedia hardwares, such as display, camera, mdp and
	  video codec. And VCP support is for video codec set bw in tinysys vcp.
	  Say no if your device does not need to MMQoS support in VCP.

config INTERCONNECT_MTK_MMQOS_MT8196
	tristate "Mediatek MT8196 MMQoS interconnect driver"
	depends on INTERCONNECT_MTK
	depends on MTK_SMI
	depends on MTK_MMQOS_VCP
	select INTERCONNECT_MTK_MMQOS_COMMON
	help
	  Support MT8196 for multimedia QoS in Mediatek's SoCs.
	  The Mediatek MMQoS(Multimedia Quality of Service) Interconnect
	  driver will collect BW requests from MM users, such as display,
	  camera, mdp and video codec, and configure SMI settings dynamically
	  according to the aggregated BW.
```

## drivers/isp/Kconfig
```kconfig
# SPDX-License-Identifier: GPL-2.0

menuconfig ISP
	bool "ISP"
	select DMA_SHARED_BUFFER
	select SYNC_FILE
	help
	  The ISP UAPI and framework.

	  Enable this if you have complex imaging related devices.

	  NOTE THAT THE ISP API IS EXPERIMENTAL. IT MAY NOT BE CONSIDERED
	  STABLE AT THE MOMENT.

	  The module will be called isp.ko.

config ISP_KUNIT_TESTS
	tristate "KUnit tests for ISP" if !KUNIT_ALL_TESTS
	depends on ISP && KUNIT
	default KUNIT_ALL_TESTS
	help
	  This builds the ISP KUnit tests.

	  KUnit tests run during boot and output the results to the debug log
	  in TAP format (https://testanything.org/). Only useful for kernel devs
	  running KUnit test harness and are not for inclusion into a production
	  build.

	  For more information on KUnit and unit tests in general please refer
	  to the KUnit documentation in Documentation/dev-tools/kunit/.

	  If unsure, say N.

if ISP

source "drivers/isp/platform/Kconfig"

endif # ISP
```

## drivers/isp/platform/visp/Kconfig
```kconfig
# SPDX-License-Identifier: GPL-2.0

config ISP_VIRTUAL_DEVICE
	tristate "Virtual ISP driver"
	help
	  Driver for a virtual ISP device.

	  This driver creates a virtual ISP device that emulates an ISP device
	  without depending on any particular hardware. It can be used to test
	  both userspace code against the ISP API, and the ISP subsystem core.

	  The module will be called visp.ko.
```

## drivers/manatee/Kconfig
```kconfig
# SPDX-License-Identifier: GPL-2.0
menu "ManaTEE driver support"
	depends on MANATEE

config MANATEE_HYP
	bool "ManaTEE hypervisor mode"
	depends on KVM
	help
	  Select to indicate the kernel is running as ManaTEE hypervisor.

endmenu
```

## drivers/media/platform/google/chameleonv3/Kconfig
```kconfig
# SPDX-License-Identifier: GPL-2.0-only

config VIDEO_CHV3_FB
	tristate "Google Chameleon v3 framebuffer video driver"
	depends on V4L_PLATFORM_DRIVERS
	depends on VIDEO_DEV
	select VIDEOBUF2_DMA_CONTIG
	select V4L2_FWNODE
	help
	  v4l2 driver for the video interface present on the Google Chameleon v3
```

## drivers/media/platform/intel/Kconfig
```kconfig
# SPDX-License-Identifier: GPL-2.0-only

comment "Intel media platform drivers"

config VIDEO_PXA27x
	tristate "PXA27x Quick Capture Interface driver"
	depends on V4L_PLATFORM_DRIVERS
	depends on VIDEO_DEV
	depends on PXA27x || COMPILE_TEST
	select VIDEOBUF2_DMA_SG
	select SG_SPLIT
	select V4L2_FWNODE
	help
	  This is a v4l2 driver for the PXA27x Quick Capture Interface

config VIDEO_INTEL_DPRX
	tristate "Intel DisplayPort RX IP driver"
	depends on V4L_PLATFORM_DRIVERS
	depends on VIDEO_DEV
	select V4L2_FWNODE
	help
	  v4l2 subdev driver for Intel Displayport receiver FPGA IP
```

## drivers/memory/mediatek/Kconfig
```kconfig
# SPDX-License-Identifier: GPL-2.0-only
#
# Memory devices
#

config MTK_SMPU
	bool "Mediatek SMPU Driver"
	default y
	help
	  Say Y here if you need mediatek smpu driver support.
	  If you don't need, say N.
```

## drivers/misc/mediatek/Kconfig
```kconfig
# SPDX-License-Identifier: (GPL-2.0 OR MIT)

source "drivers/misc/mediatek/cm_mgr/Kconfig"
source "drivers/misc/mediatek/slbc/Kconfig"
source "drivers/misc/mediatek/mmdebug/Kconfig"
source "drivers/misc/mediatek/mminfra/Kconfig"
source "drivers/misc/mediatek/mtk-interconnect/Kconfig"
source "drivers/misc/mediatek/dvfsrc/Kconfig"
```

## drivers/misc/mediatek/cm_mgr/Kconfig
```kconfig
config MTK_CM_IPI
	tristate "MTK CM use IPI"
	depends on MTK_TINYSYS_SCMI
	help
	  This kernel config can be used to enable CM IPI. When enable
	  this option, we will use ipi on system buffer to improve
	  performance and power.
	  If unsure, say N.

config MTK_CM_MGR
	tristate "MTK CPU Memory Latency Management"
	help
	  This kernel config can be used to enable CM_MGR. When enable
	  this option, dram OPP level will be changed which will depended
	  on power table.
	  If unsure, say N.

config MTK_CM_MGR_MT8196
	tristate "MTK CM_MGR for MT8196"
	depends on MTK_CM_MGR
	help
	  This kernel config can be used to enable CM_MGR MT8196. When enable
	  this option, dram OPP level will be changed which will depended
	  on power table.
	  If unsure, say N.
```

## drivers/misc/mediatek/slbc/Kconfig
```kconfig
# # SPDX-License-Identifier: (GPL-2.0 OR MIT)

config MTK_SLBC
	tristate "MTK SLBC"
	help
	  This kernel config can be used to enable SLBC (System Level Buffer and
	  Cache). When enable this option, we will use system buffer to improve
	  performance and power.
	  If unsure, say N.

config MTK_SLBC_MT8196
	tristate "MTK SLBC MT8196"
	depends on MTK_SLBC
	help
	  This kernel config can be used to enable SLBC at mt8196. When enable
	  this option, we will use system buffer to improve performance
	  and power.
	  If unsure, say N.

config MTK_SLBC_IPI
	tristate "MTK SLBC use IPI"
	help
	  This kernel config can be used to enable SLBC IPI. When enable
	  this option, we will use scmi on system buffer to improve
	  performance and power.
	  If unsure, say N.
```
