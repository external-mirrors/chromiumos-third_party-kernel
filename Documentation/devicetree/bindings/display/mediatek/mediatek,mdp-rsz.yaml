## drivers/remoteproc/mcupm/Kconfig
```kconfig
config MTK_TINYSYS_MCUPM_SUPPORT
	tristate "Specify Interface Support MCUPM"
	depends on ARCH_MEDIATEK
	help
	  MCUPM is a MediaTek in-house hardware for APMCU
	  power management
	  Set Y to enable this feature.
	  If unsure, set N to stay with legancy feature.
```

## drivers/soc/mediatek/Kconfig
```kconfig
# SPDX-License-Identifier: GPL-2.0-only
#
# MediaTek SoC drivers
#
menu "MediaTek SoC drivers"
	depends on ARCH_MEDIATEK || COMPILE_TEST

source "drivers/soc/mediatek/apusys/Kconfig"

config MTK_DVFSRC
	tristate "MediaTek DVFSRC Support"
	depends on ARCH_MEDIATEK
	select PM_GENERIC_DOMAINS if PM
	depends on MTK_SCPSYS
	help
	  Say yes here to add support for the MediaTek DVFSRC (dynamic voltage
	  and frequency scaling resource collector) found
	  on different MediaTek SoCs. The DVFSRC is a proprietary
	  hardware which is used to collect all the requests from
	  system and turn into the decision of minimum Vcore voltage
	  and minimum DRAM frequency to fulfill those requests.

config MTK_DVFSRC_START
	tristate "MediaTek DVFSRC Support"
	depends on ARCH_MEDIATEK
	select PM_GENERIC_DOMAINS if PM
	depends on MTK_SCPSYS
	depends on MTK_DVFSRC
	help
	  Say yes here to release Bandwitch for MediaTek DVFSRC,
	  the system will run in highest opp when you disable the config.
	  Please check all the requests from system is correct,
	  otherwise, the system may be hang.

config MTK_CMDQ
	tristate "MediaTek CMDQ Support"
	depends on ARCH_MEDIATEK || COMPILE_TEST
	select MAILBOX
	select MTK_CMDQ_MBOX
	select MTK_INFRACFG
	help
	  Say yes here to add support for the MediaTek Command Queue (CMDQ)
	  driver. The CMDQ is used to help read/write registers with critical
	  time limitation, such as updating display configuration during the
	  vblank.

config MTK_DEVAPC
	tristate "Mediatek Device APC Support"
	help
	  Say yes here to enable support for Mediatek Device APC driver.
	  This driver is mainly used to handle the violation which catches
	  unexpected transaction.
	  The violation information is logged for further analysis or
	  countermeasures.

config MTK_DPC
	tristate "MediaTek DPC Support"
	help
	  Say yes here to add support for the MediaTek DPC driver.
	  The DPC is used to report display bandwidth and set required
	  display vcore voltage.

config MTK_MBOX
    tristate "MediaTek Mbox Support"
    help
      Say yes here to add support for the MediaTek Mbox driver.
      MTK MBOX is a physical H/W which consists of configurable 128
      or 256 bytes SRAM and 32 bit irq. The driver does read/write
      SRAM and IRQ handling.

config MTK_INFRACFG
	bool "MediaTek INFRACFG Support"
	select REGMAP
	help
	  Say yes here to add support for the MediaTek INFRACFG controller. The
	  INFRACFG controller contains various infrastructure registers not
	  directly associated to any device.

config MTK_IPI
    tristate "MediaTek IPI Support"
    depends on RPMSG_MTK
    help
      Say yes here to add support for the MediaTek IPI between tinysys.
      MTK IPI consists of APIs to do Linux to/from uP/DSP communication
      based on rpmsg. Synchronization among tasks is also handled by
      this layer. If uP/DSP drivers handle by themselves, they can use
      rpmsg directly.

config MTK_PMIC_WRAP
	tristate "MediaTek PMIC Wrapper Support"
	depends on RESET_CONTROLLER
	depends on OF
	select REGMAP
	help
	  Say yes here to add support for MediaTek PMIC Wrapper found
	  on different MediaTek SoCs. The PMIC wrapper is a proprietary
	  hardware to connect the PMIC.

config MTK_REGULATOR_COUPLER
	bool "MediaTek SoC Regulator Coupler" if COMPILE_TEST
	default ARCH_MEDIATEK
	depends on REGULATOR

config MTK_SCPSYS
	bool "MediaTek SCPSYS Support"
	default ARCH_MEDIATEK
	depends on OF
	select REGMAP
	select MTK_INFRACFG
	select PM_GENERIC_DOMAINS if PM
	help
	  Say yes here to add support for the MediaTek SCPSYS power domain
	  driver.

config MTK_SCPSYS_PM_DOMAINS
	bool "MediaTek SCPSYS generic power domain"
	default ARCH_MEDIATEK
	depends on PM
	select PM_GENERIC_DOMAINS
	select REGMAP
	help
	  Say y here to enable power domain support.
	  In order to meet high performance and low power requirements, the System
	  Control Processor System (SCPSYS) has several power management related
	  tasks in the system.

config MTK_MMSYS
	tristate "MediaTek MMSYS Support"
	default ARCH_MEDIATEK
	depends on HAS_IOMEM
	depends on MTK_CMDQ || MTK_CMDQ=n
	help
	  Say yes here to add support for the MediaTek Multimedia
	  Subsystem (MMSYS).

config MTK_SVS
	tristate "MediaTek Smart Voltage Scaling(SVS)"
	depends on NVMEM_MTK_EFUSE && NVMEM
	help
	  The Smart Voltage Scaling(SVS) engine is a piece of hardware
	  which has several controllers(banks) for calculating suitable
	  voltage to different power domains(CPU/GPU/CCI) according to
	  chip process corner, temperatures and other factors. Then DVFS
	  driver could apply SVS bank voltage to PMIC/Buck.

config MTK_SOCINFO
	tristate "MediaTek SoC Information"
	default y
	depends on NVMEM_MTK_EFUSE
	select SOC_BUS
	help
	  The MediaTek SoC Information (mtk-socinfo) driver provides
	  information about the SoC to the userspace including the
	  manufacturer name, marketing name and soc name.

config MTK_VDISP
        bool "MediaTek VDISP driver"
	select REGMAP
        help
	  The VDISP driver to manage the display power voter, ensuring
	  efficient power control for display components in MediaTek SoCs.
	  The driver mainly help to nofify MM MCU to turn on/off DISP
          buck.

config MTK_VMM
	tristate "MediaTek VMM driver"
	help
	  This VMM driver is used to manage Multimedia power voter in
	  MediaTek SoCs. The Regulator help to notify the mtcmos status
	  of each subsys to vcp when any of them is on, VMM DVFS can
	  adjust voltage level dynamically according to the status.

config MTK_MMDVFS
	tristate "MediaTek MMDVFS Support"
	depends on ARCH_MEDIATEK || COMPILE_TEST
	depends on ARCH_DMA_ADDR_T_64BIT
	depends on MTK_DVFSRC
	help
	  Say yes here to add support for the MediaTek Multimedia DVFS (MMDVFS)
	  driver. The MMDVFS is used to set clk for Mediatek multimedia hardwares
	  , such as display, camera, mdp and video codec. Say no if your device
	  does not need to do DVFS for Multimedia hardwares.

config MTK_FSOURCE
	tristate "MediaTek Fsource Support"
	depends on MFD_MT6397
	help
	  If you say yes to this option, support will be included for the
	  built-in MTK PMIC chips.

	  Say m here if you want to include fsource support as a module. This
	  will build a module called "mtk-fsource".

endmenu
```
