## drivers/gpu/drm/gna/Kconfig
```kconfig
#
# Intel(R) Gaussian & Neural Accelerator (Intel(R) GNA)
#

config DRM_GNA
	tristate "Intel(R) Gaussian & Neural Accelerator (Intel(R) GNA)"
	depends on X86 && PCI
	depends on DRM
	help
	  This option enables the Intel(R) Gaussian & Neural Accelerator
	  (Intel(R) GNA) driver: gna
	  Information about functionality is in
	  Documentation/gpu/gna.rst
```
